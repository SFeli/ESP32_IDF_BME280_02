## main/Kconfig.projbuild
```kconfig
menu "BME280 I2C-Master Configuration"

    config BME280_I2C_MASTER_SDA
        int "SDA GPIO Num"
        default 18 if IDF_TARGET_ESP32
        default 45
        help
            GPIO number for I2C Master data line of BME280.

    config BME280_I2C_MASTER_SCL
        int "SCL GPIO Num"
        default 19 if IDF_TARGET_ESP32
        default 48
        help
            GPIO number for I2C Master clock line of BME280.

    config BME280_SENSOR_ADDR
        int "BME280 Addr"
        default 76
        help
            BME280 Sensor Address 0x76 or 0x77.


endmenu
```
